## components/drv_adkey/Kconfig.projbuild
```kconfig
menu "Tostadora - Teclado analogico (AD Key)"

    config ADKEY_RAW_IDLE
        int "Lectura ADC sin pulsar nada (0-4095)"
        range 0 4095
        default 4095

    config ADKEY_RAW_UP
        int "Lectura ADC del boton ARRIBA"
        range 0 4095
        default 425

    config ADKEY_RAW_DOWN
        int "Lectura ADC del boton ABAJO"
        range 0 4095
        default 1130

    config ADKEY_RAW_LEFT
        int "Lectura ADC del boton IZQUIERDA"
        range 0 4095
        default 1830

    config ADKEY_RAW_RIGHT
        int "Lectura ADC del boton DERECHA"
        range 0 4095
        default 0

    config ADKEY_RAW_OK
        int "Lectura ADC del boton OK"
        range 0 4095
        default 2750

    config ADKEY_TOLERANCE
        int "Tolerancia (+/-) para reconocer un boton"
        range 10 1000
        default 150

endmenu
```

## components/drv_drum/Kconfig.projbuild
```kconfig
menu "Tostadora - Tambor"

    choice DRUM_OUTPUT
        prompt "Motor del tambor"
        default DRUM_OUT_L298N

        config DRUM_OUT_NONE
            bool "Sin motor (el tambor no se mueve ni se vigila)"

        config DRUM_OUT_L298N
            bool "Motor DC (TT) con L298N, un solo sentido (ENA = PWM, IN1 = sentido, IN2 a GND)"
    endchoice

    config DRUM_SPEED_PCT
        int "Velocidad de trabajo del tambor (% de PWM)"
        range 20 100
        default 60
        help
            Es el ciclo de trabajo del PWM, no las rpm. Con el L298N se pierden ~2 V,
            asi que a baja velocidad el motor puede no vencer la friccion.
            Ajustalo con la tecla 'm' del monitor (prueba del tambor).

    config DRUM_KICK_PCT
        int "Potencia del pulso de arranque (%)"
        range 50 100
        default 100

    config DRUM_KICK_MS
        int "Duracion del pulso de arranque (ms)"
        range 50 1500
        default 300
        help
            Un motor TT necesita un empujon para vencer la friccion estatica con granos.

    config DRUM_RAMP_MS
        int "Tiempo de la rampa suave desde el pulso hasta la velocidad de trabajo (ms)"
        range 50 5000
        default 600

    config DRUM_PWM_HZ
        int "Frecuencia del PWM (Hz)"
        range 500 20000
        default 2000

endmenu
```

## components/drv_fan/Kconfig.projbuild
```kconfig
menu "Tostadora - Ventilador"

    choice FAN_OUTPUT
        prompt "Como se enciende el ventilador"
        default FAN_OUT_RELAY_ACTIVE_LOW

        config FAN_OUT_NONE
            bool "Sin ventilador (no se usa ni se vigila)"

        config FAN_OUT_RELAY_ACTIVE_LOW
            bool "Canal 2 del modulo de rele, ACTIVO EN BAJO (el mismo modulo del calentador)"

        config FAN_OUT_RELAY_ACTIVE_HIGH
            bool "Canal de rele ACTIVO EN ALTO"

        config FAN_OUT_MOSFET
            bool "Modulo MOSFET (activo en alto, solo encendido y apagado)"
    endchoice

    config FAN_OPEN_DRAIN
        bool "Pin en colector abierto (recomendado para rele activo en bajo)"
        default y
        depends on FAN_OUT_RELAY_ACTIVE_LOW

    choice FAN_TACH_MODE
        prompt "Cable amarillo del ventilador (tacometro)"
        default FAN_TACH_PULSES
        depends on !FAN_OUT_NONE

        config FAN_TACH_PULSES
            bool "Pulsos de tacometro: se comprueba que el ventilador gira (recomendado)"

        config FAN_TACH_NONE
            bool "No se usa: solo se confia en la orden de encender (MENOS SEGURO)"
    endchoice

    config FAN_TACH_PPR
        int "Pulsos por vuelta del tacometro"
        range 1 4
        default 2
        depends on FAN_TACH_PULSES

    config FAN_MIN_RPM
        int "Velocidad minima para considerar que gira (rpm)"
        range 100 3000
        default 600
        depends on FAN_TACH_PULSES

    config FAN_MAX_RPM
        int "Velocidad maxima creible (rpm): por encima se considera RUIDO, no giro"
        range 3000 20000
        default 8000
        depends on FAN_TACH_PULSES

    config FAN_SPINUP_MS
        int "Tiempo que se le da al ventilador para arrancar (ms)"
        range 1000 10000
        default 3000

    config FAN_COOL_ON_C
        int "El ventilador se enciende solo si el tambor pasa de (C)"
        range 40 100
        default 60

    config FAN_COOL_OFF_C
        int "... y se apaga cuando baja de (C)"
        range 30 95
        default 55

endmenu
```

## components/drv_heater/Kconfig.projbuild
```kconfig
menu "Tostadora - Salida del calentador"

    choice HEATER_OUTPUT
        prompt "Tipo de salida que maneja la resistencia"
        default HEATER_OUT_SSR

        config HEATER_OUT_SSR
            bool "SSR (rele de estado solido, activo en ALTO, ciclo de 2 s)"

        config HEATER_OUT_RELAY_ACTIVE_LOW
            bool "Rele mecanico, modulo ACTIVO EN BAJO (el mas comun; ciclo largo)"

        config HEATER_OUT_RELAY_ACTIVE_HIGH
            bool "Rele mecanico, modulo ACTIVO EN ALTO (ciclo largo)"
    endchoice

    config HEATER_OPEN_DRAIN
        bool "Pin en colector abierto (recomendado para modulos activos en bajo)"
        default y
        depends on HEATER_OUT_RELAY_ACTIVE_LOW
        help
            El modulo de rele se alimenta con 5 V y la ESP32 da 3,3 V: a veces ese nivel
            "alto" no basta para apagar el rele. En colector abierto, el pin solo tira a
            tierra (rele ON) o se suelta (rele OFF), y el propio modulo sube la linea.

    config HEATER_RELAY_WINDOW_S
        int "Duracion del ciclo del rele (segundos)"
        range 6 30
        default 10
        depends on !HEATER_OUT_SSR
        help
            Cada ciclo el rele se enciende el porcentaje pedido de este tiempo.
            Mas largo = menos desgaste de los contactos.

    config HEATER_RELAY_MIN_S
        int "Tiempo minimo encendido o apagado (segundos)"
        range 1 5
        default 1
        depends on !HEATER_OUT_SSR
        help
            Evita maniobras muy cortas: por debajo de este tiempo el rele no se enciende,
            y por encima de (ciclo - minimo) queda encendido todo el ciclo.

endmenu
```

## components/svc_roast_manager/Kconfig.projbuild
```kconfig
menu "Tostadora - Seguridad y control"

    config SAFETY_MAX_TEMP_C
        int "Temperatura maxima de seguridad (C)"
        range 150 300
        default 250
        help
            Si el tambor supera este valor, el calentador se apaga y el sistema
            pasa a FALLA hasta que baje la temperatura y el usuario lo reinicie.

    config SAFETY_COOL_DONE_C
        int "Temperatura a la que se considera enfriado (C)"
        range 30 100
        default 60

    config SAFETY_PROX_CUTS_HEATER
        bool "La alerta de proximidad tambien apaga el calentador mientras dure"
        default n
        help
            Por defecto la alerta de proximidad solo AVISA (pantalla y buzzer).

    config BENCH_SIMULATE_SENSOR
        bool "BANCO DE PRUEBAS: temperatura SIMULADA y calentador DESHABILITADO"
        default n
        help
            Solo para probar la interfaz, la SD y el RTC cuando todavia no hay termocupla.
            La temperatura se calcula con un modelo simple y el pin del calentador
            NUNCA se pone en alto, aunque el SSR este conectado.
            DESACTIVAR antes de usar la tostadora de verdad.

endmenu
```

## components/svc_sensor/Kconfig.projbuild
```kconfig
menu "Tostadora - Sensor de temperatura"

    choice TEMP_SENSOR
        prompt "Sensor de temperatura a usar"
        default TEMP_SENSOR_MAX6675

        config TEMP_SENSOR_MAX6675
            bool "Termocupla tipo K con MAX6675 (hasta 1024 C) - para tostar"

        config TEMP_SENSOR_DS18B20
            bool "DS18B20 (SOLO hasta 125 C) - unicamente para pruebas, NO sirve para tostar"
    endchoice

endmenu

menu "Tostadora - Sensor de proximidad (TCRT5000)"

    config PROX_ACTIVE_LOW
        bool "La lectura BAJA cuando hay algo cerca"
        default y
        help
            En la mayoria de modulos TCRT5000, mas reflexion = menor voltaje en AO.
            Si en tu modulo ocurre al reves, desactivalo.

    config PROX_THRESHOLD
        int "Umbral de alerta (lectura ADC 0-4095)"
        range 0 4095
        default 2000
        help
            Se calibra mirando el monitor serial con PROX_DEBUG_LOG activo:
            anota la lectura sin nada cerca y con la mano a la distancia de alerta,
            y pon el umbral en medio.

    config PROX_DEBUG_LOG
        bool "Imprimir lectura de proximidad y temperatura cada 2 s"
        default y

endmenu
```

## sdkconfig.defaults
```kconfig
CONFIG_ESPTOOLPY_FLASHSIZE_4MB=y
CONFIG_FREERTOS_HZ=1000

CONFIG_ADKEY_RAW_IDLE=4095
CONFIG_ADKEY_RAW_UP=425
CONFIG_ADKEY_RAW_DOWN=1130
CONFIG_ADKEY_RAW_LEFT=1830
CONFIG_ADKEY_RAW_RIGHT=0
CONFIG_ADKEY_RAW_OK=2750
CONFIG_ADKEY_TOLERANCE=150
```
